## CMakeLists.txt
```
#
# Copyright (c) 2018 Nordic Semiconductor
#
# SPDX-License-Identifier: LicenseRef-BSD-5-Clause-Nordic
#
cmake_minimum_required(VERSION 3.8.2)

include($ENV{ZEPHYR_BASE}/cmake/app/boilerplate.cmake NO_POLICY_SCOPE)
project(NONE)

FILE(GLOB app_sources src/*.c)
# NORDIC SDK APP START
target_sources(app  PRIVATE ${app_sources})
# NORDIC SDK APP END
```

## prj.conf
```kconfig
#
# Copyright (c) 2019 Nordic Semiconductor ASA
#
# SPDX-License-Identifier: LicenseRef-BSD-5-Clause-Nordic
#
CONFIG_DK_LIBRARY=y
CONFIG_NORDIC_SECURITY_BACKEND=y
CONFIG_MBEDTLS_VANILLA_BACKEND=y
CONFIG_MBEDTLS_X509_LIBRARY=y
CONFIG_MBEDTLS_TLS_LIBRARY=y

CONFIG_VANILLA_MBEDTLS_AES_C=y
CONFIG_VANILLA_MBEDTLS_CMAC_C=y
# CONFIG_MBEDTLS_AES_256_CMAC_C=n
CONFIG_MBEDTLS_CIPHER_MODE_XTS=n

CONFIG_CC310_MBEDTLS_AES_C=n
CONFIG_CC310_MBEDTLS_CMAC_C=n

CONFIG_VANILLA_MBEDTLS_GCM_C=n

CONFIG_MBEDTLS_CHACHA20_C=n
CONFIG_MBEDTLS_POLY1305_C=n
CONFIG_MBEDTLS_CHACHAPOLY_C=n

CONFIG_MBEDTLS_RSA_C=n
CONFIG_MBEDTLS_SHA1_C=n
CONFIG_MBEDTLS_SHA512_C=n

CONFIG_NRF_SECURITY_ADVANCED=y
CONFIG_MBEDTLS_MPI_WINDOW_SIZE=1
CONFIG_MBEDTLS_MPI_MAX_SIZE=32
CONFIG_MBEDTLS_ECP_MAX_BITS=256
CONFIG_MBEDTLS_ECP_WINDOW_SIZE=2
CONFIG_MBEDTLS_ECP_FIXED_POINT_OPTIM=n
CONFIG_MBEDTLS_SSL_MAX_CONTENT_LEN=900
CONFIG_MBEDTLS_SSL_CIPHERSUITES="MBEDTLS_TLS_ECJPAKE_WITH_AES_128_CCM_8"

CONFIG_MBEDTLS_PK_C=y
CONFIG_MBEDTLS_PK_WRITE_C=y
CONFIG_MBEDTLS_CHACHA20_C=y
CONFIG_MBEDTLS_POLY1305_C=y
CONFIG_MBEDTLS_CHACHAPOLY_C=y
CONFIG_CC310_MBEDTLS_POLY1305_C=y
CONFIG_CC310_MBEDTLS_CHACHAPOLY_C=y
CONFIG_CC310_MBEDTLS_CHACHA20_C=y
CONFIG_MBEDTLS_SHA1_C=y
CONFIG_MBEDTLS_SHA512_C=y

CONFIG_FP_HARDABI=y
CONFIG_FLOAT=y
```

## overlay-short-wchar.conf
```kconfig
#
# Copyright (c) 2019 Nordic Semiconductor ASA
#
# SPDX-License-Identifier: LicenseRef-BSD-5-Clause-Nordic
#
CONFIG_SHORT_WCHAR_T=y
```

## src/main.c
```c
/*
 * Copyright (c) 2018 Nordic Semiconductor ASA
 *
 * SPDX-License-Identifier: LicenseRef-BSD-5-Clause-Nordic
 */

#include <zephyr.h>
#include <misc/printk.h>

#include <dk_buttons_and_leds.h>

//		dk_set_led_on(DK_LED1);


#include <mbedtls/sha256.h>
#include <mbedtls/aes.h>
// #include <mbedtls/platform.h>
// #include <nrf_cc310_platform_mutex.h>
// #include <nrf_cc310_platform_abort.h>

static unsigned char hash[32];
// mbedtls_platform_context ctx;
mbedtls_aes_context a_ctx;
uint8_t key[32];

int main(void)
{
	int r;
	if (dk_leds_init() < 0) {
		printk("Cannot init LEDs!\n");
		return 1;
	}
	printk("START\n");
	// nrf_cc310_platform_abort_init();
	// nrf_cc310_platform_mutex_init();
	// r = mbedtls_platform_setup(&ctx);
	// if (r != 0) printk("Error %d at %d\n", r, __LINE__);
	r = mbedtls_sha256_ret("Hello World!", 12, hash, 0);
	if (r != 0) printk("Error %d at %d\n", r, __LINE__);
	for (r = 0; r < sizeof(hash); r++)
	{
		printk("%02X ", hash[r]);
	}
	mbedtls_aes_init(&a_ctx);
	r = mbedtls_aes_setkey_enc(&a_ctx, key, 256);
	if (r != 0) printk("Error %d at %d\n", r, __LINE__);
	printk("\nEND\n");
	return 0;
}
```
